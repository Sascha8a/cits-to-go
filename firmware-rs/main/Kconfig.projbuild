## firmware-rs/main/Kconfig.projbuild
```kconfig
menu "CITS-to-go Configuration"

    config CITS_RX_FREQUENCY_MHZ
        int "C-ITS receive/transmit frequency in MHz"
        range 5860 5900
        default 5900
        help
            ITS-G5 channel center frequency. Common values are 5900 for G5CC,
            5890 for G5SC2, 5880 for G5SC1, 5870 for G5SC3, and 5860 for G5SC4.

    config CITS_BROADCAST_ONLY
        bool "Capture only broadcast 802.11 frames"
        default y
        help
            C-ITS messages are normally sent to the broadcast destination
            address. Filtering here reduces serial bandwidth and CPU work.

    config CITS_PACKET_POOL_SIZE
        int "Packet buffer pool size"
        range 4 64
        default 8
        help
            Number of fixed packet buffers available to the Wi-Fi receive
            callback.

    config CITS_MAX_PACKET_BYTES
        int "Maximum captured packet bytes"
        range 512 4096
        default 2352
        help
            Packets larger than this are dropped and counted in the drop stats.

    config CITS_TX_POOL_SIZE
        int "Transmit request buffer pool size"
        range 2 32
        default 4
        help
            Number of bounded raw 802.11 transmit requests that can wait for
            the radio. A full queue is reported to Android as ESP_ERR_NO_MEM.

    config CITS_SERIAL_READ_TIMEOUT_MS
        int "USB serial read timeout in milliseconds"
        range 1 1000
        default 20

    config CITS_SERIAL_WRITE_TIMEOUT_MS
        int "USB serial write timeout in milliseconds"
        range 1 1000
        default 100

    config CITS_LED_GPIO
        int "USER LED GPIO"
        default 27
        help
            Seeed Studio XIAO ESP32-C5 USER LED is connected to GPIO27.

    config CITS_LED_ACTIVE_LOW
        bool "USER LED is active low"
        default y

    config CITS_LED_PULSE_MS
        int "Accepted packet LED pulse in milliseconds"
        range 1 1000
        default 35

endmenu
```

## firmware-rs/sdkconfig.defaults
```kconfig
CONFIG_IDF_TARGET="esp32c5"
CONFIG_IDF_TARGET_ESP32C5=y
CONFIG_ESPTOOLPY_FLASHSIZE_8MB=y
CONFIG_ESPTOOLPY_FLASHSIZE="8MB"
CONFIG_ESPTOOLPY_FLASHFREQ_80M=y
CONFIG_ESPTOOLPY_FLASHFREQ="80m"
CONFIG_ESPTOOLPY_FLASHMODE_DIO=y
CONFIG_ESPTOOLPY_FLASHMODE="dio"
CONFIG_BOOTLOADER_LOG_LEVEL_WARN=y
CONFIG_BOOTLOADER_LOG_LEVEL=2
CONFIG_LOG_DEFAULT_LEVEL_NONE=y
CONFIG_LOG_DEFAULT_LEVEL=0
CONFIG_ESP_CONSOLE_NONE=y

CONFIG_BT_ENABLED=y
CONFIG_BT_NIMBLE_ENABLED=y
CONFIG_BT_NIMBLE_ROLE_PERIPHERAL=y
CONFIG_BT_NIMBLE_ROLE_BROADCASTER=y
CONFIG_BT_NIMBLE_MAX_CONNECTIONS=1
CONFIG_BT_NIMBLE_MAX_BONDS=2
CONFIG_BT_NIMBLE_NVS_PERSIST=y
CONFIG_BT_NIMBLE_ATT_PREFERRED_MTU=517
CONFIG_BT_NIMBLE_MSYS_2_BLOCK_COUNT=24
CONFIG_BT_NIMBLE_SECURITY_ENABLE=y
CONFIG_BT_NIMBLE_SM_SC=y
CONFIG_BT_NIMBLE_SM_LEGACY=n
CONFIG_BT_NIMBLE_SM_SC_DEBUG_KEYS=n
CONFIG_BT_NIMBLE_LL_CFG_FEAT_LE_ENCRYPTION=y

# Rust Embassy's one executor runs on app_main; futures live in static storage.
CONFIG_ESP_MAIN_TASK_STACK_SIZE=8192
CONFIG_ESP_MAIN_TASK_AFFINITY_CPU0=y
CONFIG_COMPILER_OPTIMIZATION_PERF=y
CONFIG_COMPILER_OPTIMIZATION_SIZE=n

# Keep bond-storage offsets unchanged, with room for application growth.
CONFIG_PARTITION_TABLE_CUSTOM=y
CONFIG_PARTITION_TABLE_CUSTOM_FILENAME="partitions.csv"
CONFIG_PARTITION_TABLE_FILENAME="partitions.csv"

CONFIG_CITS_PACKET_POOL_SIZE=8
CONFIG_CITS_TX_POOL_SIZE=4
```

## firmware/main/Kconfig.projbuild
```kconfig
menu "CITS-to-go Configuration"

    config CITS_RX_FREQUENCY_MHZ
        int "C-ITS receive frequency in MHz"
        range 5860 5900
        default 5900
        help
            ITS-G5 channel center frequency. Common values are 5900 for G5CC,
            5890 for G5SC2, 5880 for G5SC1, 5870 for G5SC3, and 5860 for G5SC4.

    config CITS_BROADCAST_ONLY
        bool "Capture only broadcast 802.11 frames"
        default y
        help
            C-ITS messages are normally sent to the broadcast destination
            address. Filtering here reduces serial bandwidth and CPU work.

    config CITS_PACKET_POOL_SIZE
        int "Packet buffer pool size"
        range 4 64
        default 16
        help
            Number of fixed packet buffers available to the Wi-Fi receive
            callback.

    config CITS_MAX_PACKET_BYTES
        int "Maximum captured packet bytes"
        range 512 4096
        default 2352
        help
            Packets larger than this are dropped and counted in the drop stats.

    choice CITS_SERIAL_OUTPUT
        prompt "Packet output"
        default CITS_SERIAL_OUTPUT_USB_AND_SPI
        help
            Select where accepted packet records are written. All outputs use
            the same CTG1 COBS-delimited binary framing.

        config CITS_SERIAL_OUTPUT_USB
            bool "USB Serial/JTAG only"

        config CITS_SERIAL_OUTPUT_SPI
            bool "GPIO SPI only"

        config CITS_SERIAL_OUTPUT_USB_AND_SPI
            bool "USB Serial/JTAG and GPIO SPI"
    endchoice

    config CITS_SERIAL_WRITE_TIMEOUT_MS
        int "Serial write timeout in milliseconds"
        range 1 1000
        default 100

    config CITS_SPI_CLOCK_HZ
        int "GPIO SPI clock in Hz"
        range 100000 20000000
        default 4000000
        depends on CITS_SERIAL_OUTPUT_SPI || CITS_SERIAL_OUTPUT_USB_AND_SPI

    config CITS_SPI_CS_GPIO
        int "GPIO SPI CS GPIO"
        range 0 31
        default 0
        depends on CITS_SERIAL_OUTPUT_SPI || CITS_SERIAL_OUTPUT_USB_AND_SPI
        help
            XIAO ESP32-C5 D1 is GPIO0.

    config CITS_SPI_READY_GPIO
        int "GPIO SPI ready GPIO"
        range 0 31
        default 25
        depends on CITS_SERIAL_OUTPUT_SPI || CITS_SERIAL_OUTPUT_USB_AND_SPI
        help
            XIAO ESP32-C5 D2 is GPIO25. The uplink board drives this high
            when its SPI slave transaction buffer is ready.

    config CITS_SPI_MOSI_GPIO
        int "GPIO SPI MOSI GPIO"
        range 0 31
        default 7
        depends on CITS_SERIAL_OUTPUT_SPI || CITS_SERIAL_OUTPUT_USB_AND_SPI
        help
            XIAO ESP32-C5 D3 is GPIO7.

    config CITS_SPI_MISO_GPIO
        int "GPIO SPI MISO GPIO"
        range -1 31
        default 23
        depends on CITS_SERIAL_OUTPUT_SPI || CITS_SERIAL_OUTPUT_USB_AND_SPI
        help
            XIAO ESP32-C5 D4 is GPIO23. Set to -1 if MISO is not wired.

    config CITS_SPI_CLK_GPIO
        int "GPIO SPI clock GPIO"
        range 0 31
        default 24
        depends on CITS_SERIAL_OUTPUT_SPI || CITS_SERIAL_OUTPUT_USB_AND_SPI
        help
            XIAO ESP32-C5 D5 is GPIO24.

    config CITS_SPI_READY_TIMEOUT_MS
        int "SPI ready timeout in milliseconds"
        range 1 1000
        default 100
        depends on CITS_SERIAL_OUTPUT_SPI || CITS_SERIAL_OUTPUT_USB_AND_SPI

    config CITS_LED_GPIO
        int "USER LED GPIO"
        default 27
        help
            Seeed Studio XIAO ESP32-C5 USER LED is connected to GPIO27.

    config CITS_LED_ACTIVE_LOW
        bool "USER LED is active low"
        default y

    config CITS_LED_PULSE_MS
        int "Accepted packet LED pulse in milliseconds"
        range 1 1000
        default 35

endmenu
```

## firmware/sdkconfig.defaults
```kconfig
CONFIG_IDF_TARGET="esp32c5"
CONFIG_IDF_TARGET_ESP32C5=y
CONFIG_ESPTOOLPY_FLASHSIZE_8MB=y
CONFIG_ESPTOOLPY_FLASHSIZE="8MB"
CONFIG_ESPTOOLPY_FLASHFREQ_80M=y
CONFIG_ESPTOOLPY_FLASHFREQ="80m"
CONFIG_ESPTOOLPY_FLASHMODE_DIO=y
CONFIG_ESPTOOLPY_FLASHMODE="dio"
CONFIG_BOOTLOADER_LOG_LEVEL_WARN=y
CONFIG_BOOTLOADER_LOG_LEVEL=2
CONFIG_LOG_DEFAULT_LEVEL_NONE=y
CONFIG_LOG_DEFAULT_LEVEL=0
CONFIG_ESP_CONSOLE_NONE=y
CONFIG_COMPILER_OPTIMIZATION_SIZE=y

CONFIG_BT_ENABLED=y
CONFIG_BT_NIMBLE_ENABLED=y
CONFIG_BT_NIMBLE_ROLE_PERIPHERAL=y
CONFIG_BT_NIMBLE_ROLE_BROADCASTER=y
CONFIG_BT_NIMBLE_MAX_CONNECTIONS=1
CONFIG_BT_NIMBLE_MAX_BONDS=2
CONFIG_BT_NIMBLE_NVS_PERSIST=y
CONFIG_BT_NIMBLE_ATT_PREFERRED_MTU=517
CONFIG_BT_NIMBLE_MSYS_2_BLOCK_COUNT=48
CONFIG_BT_NIMBLE_SECURITY_ENABLE=y
CONFIG_BT_NIMBLE_SM_SC=y
CONFIG_BT_NIMBLE_SM_LEGACY=n
CONFIG_BT_NIMBLE_SM_SC_DEBUG_KEYS=n
CONFIG_BT_NIMBLE_LL_CFG_FEAT_LE_ENCRYPTION=y
```

## wifi-uplink-firmware/main/Kconfig.projbuild
```kconfig
menu "CITS-to-go Wi-Fi uplink Configuration"

    config CITS_UPLINK_WIFI_SSID
        string "Wi-Fi SSID"
        default "WillkommenimVOR-1"

    config CITS_UPLINK_WIFI_PASSWORD
        string "Wi-Fi password"
        default "DerVORverbindet!"

    config CITS_UPLINK_MQTT_URI
        string "MQTT broker URI"
        default "mqtts://cits1.opentrafficmap.org"
        help
            MQTT URI compatible with the Android bridge. Use mqtt:// for
            plaintext port 1883 or mqtts:// for TLS port 8883.

    config CITS_UPLINK_NODE_ID
        string "MQTT node ID"
        default ""
        help
            Leave empty to derive a 12-hex-digit node ID from the uplink
            board's Wi-Fi station MAC address.

    config CITS_UPLINK_SPI_CS_GPIO
        int "SPI CS GPIO"
        range 0 31
        default 0
        help
            XIAO ESP32-C5 D1 is GPIO0.

    config CITS_UPLINK_SPI_READY_GPIO
        int "SPI ready GPIO"
        range 0 31
        default 25
        help
            XIAO ESP32-C5 D2 is GPIO25. This firmware drives it high when
            an SPI slave receive transaction is ready.

    config CITS_UPLINK_SPI_MOSI_GPIO
        int "SPI MOSI GPIO"
        range 0 31
        default 7
        help
            XIAO ESP32-C5 D3 is GPIO7.

    config CITS_UPLINK_SPI_MISO_GPIO
        int "SPI MISO GPIO"
        range -1 31
        default 23
        help
            XIAO ESP32-C5 D4 is GPIO23. Set to -1 if MISO is not wired.

    config CITS_UPLINK_SPI_CLK_GPIO
        int "SPI clock GPIO"
        range 0 31
        default 24
        help
            XIAO ESP32-C5 D5 is GPIO24.

    config CITS_UPLINK_STATUS_INTERVAL_MS
        int "MQTT stats publish interval in milliseconds"
        range 1000 600000
        default 60000

    config CITS_UPLINK_LED_GPIO
        int "Wi-Fi connected LED GPIO"
        default 27
        help
            Seeed Studio XIAO ESP32-C5 USER LED is connected to GPIO27.

    config CITS_UPLINK_LED_ACTIVE_LOW
        bool "Wi-Fi connected LED is active low"
        default y

    config CITS_UPLINK_HEALTH_CHECK_INTERVAL_MS
        int "Health check interval in milliseconds"
        range 1000 60000
        default 5000

    config CITS_UPLINK_WIFI_RECOVERY_INTERVAL_MS
        int "Wi-Fi reconnect retry interval in milliseconds"
        range 1000 300000
        default 15000

    config CITS_UPLINK_WIFI_RESTART_AFTER_MS
        int "Restart after Wi-Fi is down for this many milliseconds"
        range 30000 3600000
        default 300000

    config CITS_UPLINK_MQTT_RECOVERY_MS
        int "Cycle Wi-Fi after MQTT is disconnected for this many milliseconds"
        range 30000 3600000
        default 120000

    config CITS_UPLINK_TASK_STALL_RESTART_MS
        int "Restart after serial uplink task stalls for this many milliseconds"
        range 30000 3600000
        default 60000

endmenu
```

## wifi-uplink-firmware/sdkconfig.defaults
```kconfig
CONFIG_IDF_TARGET="esp32c5"
CONFIG_IDF_TARGET_ESP32C5=y
CONFIG_ESPTOOLPY_FLASHSIZE_8MB=y
CONFIG_ESPTOOLPY_FLASHSIZE="8MB"
CONFIG_ESPTOOLPY_FLASHFREQ_80M=y
CONFIG_ESPTOOLPY_FLASHFREQ="80m"
CONFIG_ESPTOOLPY_FLASHMODE_DIO=y
CONFIG_ESPTOOLPY_FLASHMODE="dio"
CONFIG_BOOTLOADER_LOG_LEVEL_WARN=y
CONFIG_BOOTLOADER_LOG_LEVEL=2
CONFIG_LOG_DEFAULT_LEVEL_INFO=y
CONFIG_LOG_DEFAULT_LEVEL=3
CONFIG_COMPILER_OPTIMIZATION_SIZE=y
CONFIG_MBEDTLS_CERTIFICATE_BUNDLE=y
CONFIG_PARTITION_TABLE_CUSTOM=y
CONFIG_PARTITION_TABLE_CUSTOM_FILENAME="partitions.csv"
CONFIG_PARTITION_TABLE_FILENAME="partitions.csv"
CONFIG_CITS_UPLINK_SPI_CS_GPIO=0
CONFIG_CITS_UPLINK_SPI_READY_GPIO=25
CONFIG_CITS_UPLINK_SPI_MOSI_GPIO=7
CONFIG_CITS_UPLINK_SPI_MISO_GPIO=23
CONFIG_CITS_UPLINK_SPI_CLK_GPIO=24
CONFIG_CITS_UPLINK_LED_GPIO=27
CONFIG_CITS_UPLINK_LED_ACTIVE_LOW=y
CONFIG_CITS_UPLINK_HEALTH_CHECK_INTERVAL_MS=5000
CONFIG_CITS_UPLINK_WIFI_RECOVERY_INTERVAL_MS=15000
CONFIG_CITS_UPLINK_WIFI_RESTART_AFTER_MS=300000
CONFIG_CITS_UPLINK_MQTT_RECOVERY_MS=120000
CONFIG_CITS_UPLINK_TASK_STALL_RESTART_MS=60000
```
